## sdkconfig.defaults
```kconfig
# ESP32-S3 Configuration for Walter NB-IoT
# Increase stack sizes to prevent overflow

# Main task stack size (default is 3584, increase to 16KB)
CONFIG_ESP_MAIN_TASK_STACK_SIZE=16384

# Enable stack overflow detection
CONFIG_FREERTOS_WATCHPOINT_END_OF_STACK=y

# Increase system event task stack
CONFIG_ESP_SYSTEM_EVENT_TASK_STACK_SIZE=4096

# Enable verbose logging for debugging
CONFIG_LOG_DEFAULT_LEVEL_INFO=y
CONFIG_LOG_MAXIMUM_LEVEL_VERBOSE=y
```
